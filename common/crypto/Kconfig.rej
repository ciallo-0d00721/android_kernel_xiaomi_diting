## common/crypto/Kconfig.rej
```kconfig
diff a/crypto/Kconfig b/crypto/Kconfig	(rejected hunks)
@@ -1815,12 +1815,30 @@
 	select CRYPTO_ACOMP2
 	select LZ4_COMPRESS
 	select LZ4_DECOMPRESS
 	help
 	  This is the LZ4 algorithm.

+config CRYPTO_LZ4K
+	tristate "LZ4K"
+	select CRYPTO_ALGAPI
+	select CRYPTO_ACOMP2
+	select LZ4K_COMPRESS
+	select LZ4K_DECOMPRESS
+	help
+	  LZ4K compression algorithm
+
+config CRYPTO_LZ4KD
+	tristate "LZ4KD"
+	select CRYPTO_ALGAPI
+	select CRYPTO_ACOMP2
+	select LZ4KD_COMPRESS
+	select LZ4KD_DECOMPRESS
+	help
+	  LZ4KD compression algorithm
+
 config CRYPTO_LZ4HC
 	tristate "LZ4HC compression algorithm"
 	select CRYPTO_ALGAPI
 	select CRYPTO_ACOMP2
 	select LZ4HC_COMPRESS
 	select LZ4_DECOMPRESS
```

## common/lib/Kconfig.rej
```kconfig
diff a/lib/Kconfig b/lib/Kconfig	(rejected hunks)
@@ -307,12 +307,24 @@
 config LZ4HC_COMPRESS
 	tristate

 config LZ4_DECOMPRESS
 	tristate

+config LZ4K_COMPRESS
+	tristate
+
+config LZ4K_DECOMPRESS
+	tristate
+
+config LZ4KD_COMPRESS
+	tristate
+
+config LZ4KD_DECOMPRESS
+	tristate
+
 config ZSTD_COMPRESS
 	select XXHASH
 	tristate

 config ZSTD_DECOMPRESS
 	select XXHASH
```
